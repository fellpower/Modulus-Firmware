## firmware/modulus-zigbee-node/sdkconfig.defaults
```kconfig
CONFIG_ZB_ENABLED=y
CONFIG_ZB_ZCZR=y
CONFIG_ESPTOOLPY_FLASHSIZE_4MB=y
CONFIG_ESP_CONSOLE_USB_SERIAL_JTAG=y
CONFIG_ESP_CONSOLE_SECONDARY_NONE=y
CONFIG_PARTITION_TABLE_CUSTOM=y
CONFIG_PARTITION_TABLE_CUSTOM_FILENAME="partitions.csv"
```

## firmware/s3-bridge/main/Kconfig.projbuild
```kconfig
menu "Modulus S3 bridge board"

    choice S3_BRIDGE_BOARD
        prompt "Cabinet bridge hardware"
        default S3_BRIDGE_BOARD_MINI1
        help
            Pin map when NVS has no saved `board` key. USB shell `board` lists
            all profiles; `board <id>` remaps UART/LED/HALT on ESP32-S3.

        config S3_BRIDGE_BOARD_MINI1
            bool "ESP32-S3-MINI-1 (handwheel / I2C_ESP32_Module)"

        config S3_BRIDGE_BOARD_XIAO
            bool "Seeed XIAO ESP32-S3 (USB-C)"
            help
                UART1 on D6/D7 (GPIO43/44). HALT on D0 (GPIO1). User LED GPIO21
                active-low. Shell on USB Serial/JTAG. Do not drive GPIO33-37
                (octal PSRAM on ESP32-S3R8).

        config S3_BRIDGE_BOARD_GENERIC
            bool "Generic ESP32-S3 Super Mini"
            help
                UART1 on GPIO43/44, HALT on GPIO1 and onboard WS2812 on
                GPIO48. This is the safe generic default; it does not bind
                UART RX to GPIO9.

    endchoice

endmenu
```

## firmware/s3-bridge/sdkconfig.defaults.generic
```kconfig
# Generic ESP32-S3 Super Mini overlay:
#   .\scripts\build_s3_bridge.ps1 -Board generic -Action fullclean
#   .\scripts\build_s3_bridge.ps1 -Board generic

CONFIG_S3_BRIDGE_BOARD_MINI1=n
CONFIG_S3_BRIDGE_BOARD_XIAO=n
CONFIG_S3_BRIDGE_BOARD_GENERIC=y
```
